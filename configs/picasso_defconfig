## configs/picasso_platform_defconfig
```kconfig
# Source-kernel platform bring-up, before original Apple component prelink.
CONFIG_XNU_SOURCE_CORECRYPTO14=y
CONFIG_XNU_SOURCE_PTHREAD=y
CONFIG_XNU_ARM_DT_PLATFORM=y
CONFIG_XNU_ARMCPU=y
CONFIG_XNU_NATIVE_ARCH_TIMER=y
CONFIG_XNU_NATIVE_PAN=y
CONFIG_XNU_CRYPTO_BOOTSTRAP="source"
CONFIG_XNU_BUILD_ARCHIVES=y
# CONFIG_XNU_ARMVIRT_PLATFORM is not set
CONFIG_XNU_SHENG_PMGR=y
# CONFIG_XNU_NATIVE_RAM_BLOCK is not set
CONFIG_XNU_NATIVE_UFS=y
CONFIG_XNU_NATIVE_ADRENO=y
# CONFIG_XNU_NATIVE_LEGACY_DISPLAY is not set
```
